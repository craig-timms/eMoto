/**************************************************************************
 This is an example for our Monochrome OLEDs based on SSD1306 drivers

 Pick one up today in the adafruit shop!
 ------> http://www.adafruit.com/category/63_98

 This example is for a 128x64 pixel display using I2C to communicate
 3 pins are required to interface (two I2C and one reset).

 Adafruit invests time and resources providing this open
 source code, please support Adafruit and open-source
 hardware by purchasing products from Adafruit!

 Written by Limor Fried/Ladyada for Adafruit Industries,
 with contributions from the open source community.
 BSD license, check license.txt for more information
 All text above, and the splash screen below must be
 included in any redistribution.
 **************************************************************************/

#include <SPI.h>
#include <Wire.h>
#include <Adafruit_GFX.h>
#include <Adafruit_SSD1306.h>
#include "FastLED.h"

#define SCREEN_WIDTH 128 // OLED display width, in pixels
#define SCREEN_HEIGHT 64 // OLED display height, in pixels

// Declaration for an SSD1306 display connected to I2C (SDA, SCL pins)
#define OLED_RESET     -1 // Reset pin # (or -1 if sharing Arduino reset pin)
Adafruit_SSD1306 display(SCREEN_WIDTH, SCREEN_HEIGHT, &Wire, OLED_RESET);
Adafruit_SSD1306 display2(SCREEN_WIDTH, SCREEN_HEIGHT, &Wire, OLED_RESET);

#define NUMFLAKES     10 // Number of snowflakes in the animation example

#define LOGO_HEIGHT   16
#define LOGO_WIDTH    16
static const unsigned char PROGMEM logo_bmp[] =
{ B00000000, B11000000,
  B00000001, B11000000,
  B00000001, B11000000,
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  B00000000, B00110000 };

const unsigned char bitmapCBE [] PROGMEM = {
  // 'CBE, 128x64px
  0xff, 0xff, 0xff, 0xff, 0xff, 0xff, 0xff, 0xff, 0xff, 0xff, 0xff, 0xff, 0xff, 0xff, 0xff, 0xff, 
  0xff, 0xff, 0xff, 0xff, 0xff, 0xff, 0xff, 0xff, 0xff, 0xff, 0xff, 0xff, 0xff, 0xff, 0xff, 0xff, 
  0xff, 0xff, 0xff, 0xff, 0xff, 0xff, 0xff, 0xff, 0xff, 0xff, 0xff, 0xff, 0xff, 0xff, 0xff, 0xff, 
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  0xff, 0xff, 0xff, 0xff, 0xff, 0xff, 0xff, 0xff, 0xff, 0xff, 0xff, 0xff, 0xff, 0xff, 0xff, 0xff
};

const unsigned char bitmapPB [] PROGMEM = {
  // 'PB2, 128x64px
  0x00, 0xff, 0xff, 0xff, 0xff, 0xff, 0xff, 0xff, 0xff, 0xff, 0xff, 0xff, 0xff, 0xff, 0xff, 0x00, 
  0x00, 0xfc, 0x18, 0x3e, 0x3c, 0x00, 0xe0, 0x03, 0x81, 0x84, 0x83, 0x88, 0xc7, 0x10, 0x07, 0x00, 
  0x00, 0xfc, 0x08, 0x18, 0x1c, 0x40, 0x80, 0x03, 0x80, 0x88, 0x81, 0x81, 0x02, 0x10, 0x07, 0x00, 
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  0x00, 0x00, 0x00, 0x00, 0x00, 0x00, 0x00, 0x00, 0x00, 0x00, 0x00, 0x00, 0x00, 0x00, 0x00, 0x00
};

float vR[]    = {0,  0,  0,  0,  0 };
float iR[]    = {0,  0,  0,  0,  0 };
float pR[]    = {0,  0,  0,  0,  0 };

#define GPIO_LED_DASH   14
#define NUM_LEDS_DASH   5

CRGB leds_dash[NUM_LEDS_DASH];

void setupLED(void) {
  FastLED.addLeds<WS2811, GPIO_LED_DASH, GRB>(leds_dash, NUM_LEDS_DASH);
  FastLED.setBrightness(10);
  delay(100);
}

void runLED(void) {
  for (int i = 0; i < NUM_LEDS_DASH; i = i + 1)
  {
    leds_dash[i] = CRGB(255, 0, 0);
  }
  FastLED.show();
  delay(1000);
  for (int i = 0; i < NUM_LEDS_DASH; i = i + 1)
  {
    leds_dash[i] = CRGB(0, 255, 0);
  }
  FastLED.show();
  delay(1000);
}

void setup() {
  Serial.begin(9600);

  // SSD1306_SWITCHCAPVCC = generate display voltage from 3.3V internally
  if(!display.begin(SSD1306_SWITCHCAPVCC, 0x3D)) { // Address 0x3D 0x7A for 128x64
    Serial.println(F("SSD1306 allocation failed"));
    for(;;); // Don't proceed, loop forever
  }
  delay(1000);
  if(!display2.begin(SSD1306_SWITCHCAPVCC, 0x3C)) { // Address 0x3D for 128x64
    Serial.println(F("Second SSD1306 allocation failed"));
    for(;;); // Don't proceed, loop forever
  }

  setupLED();

  screen1( 0 );
//  drawBitmap1();    // Draw a small bitmap image

  drawBitmap2();    // Draw a small bitmap image

  // Invert and restore display, pausing in-between
  display.invertDisplay(true);
  display2.invertDisplay(true);
  delay(1000);
  display.invertDisplay(false);
  display2.invertDisplay(false);
  delay(4000);

  screen1( 1 );

}

void loop() {
  runLED();
}

void screen1( int state ) {
  display.clearDisplay();
  display.setCursor(0, 0);
  display.setTextSize(2);
  display.setTextColor(WHITE); // Draw 'inverse' text
//  display.println(state[0]);
  
  if ( state == 1 ) {
    // Battery Voltage 1
    display.print(vR[0], 2);
    display.setTextSize(1);
    display.print(F("V "));
    display.setTextSize(2);
    // Battery Voltage 2
    display.print(vR[1], 2);
    display.setTextSize(1);
    display.print(F("V "));
    display.setTextSize(2);
    display.print(F("\n"));       // new line
    // Battery Voltage 3
    display.print(vR[2], 2);
    display.setTextSize(1);
    display.print(F("V "));
    display.setTextSize(2);
    // Battery Voltage 4
    display.print(vR[3], 2);
    display.setTextSize(1);
    display.print(F("V "));
    display.setTextSize(2);
    display.print(F("\n"));       // new line
    // Battery Voltage 5
    display.print(vR[4], 2);
    display.setTextSize(1);
    display.print(F("V "));
    display.setTextSize(2);
    display.print(F("\n"));       // new line
    display.display();
  } else if ( state == 0 ) {
    drawBitmap1();
  }
}

void testdrawchar(void) {
  display.clearDisplay();

  display.setTextSize(1);      // Normal 1:1 pixel scale
  display.setTextColor(SSD1306_WHITE); // Draw white text
  display.setCursor(0, 0);     // Start at top-left corner
  display.cp437(true);         // Use full 256 char 'Code Page 437' font

  // Not all the characters will fit on the display. This is normal.
  // Library will draw what it can and the rest will be clipped.
  for(int16_t i=0; i<256; i++) {
    if(i == '\n') display.write(' ');
    else          display.write(i);
  }

  display.display();
  delay(2000);
}

void drawBitmap1(void) {
  display.clearDisplay();

  display.drawBitmap(
    0,
    0,
    bitmapPB, 128, 64, 1);
//  display.drawBitmap(0.0, myBitmapBitmap, 128.64, WHITE);
  display.display();
  delay(1000);
}

void drawBitmap2(void) {
  display2.clearDisplay();

  display2.drawBitmap(
    0,
    0,
    bitmapCBE, 128, 64, 1);
//  display2.drawBitmap(0.0, myBitmapBitmap, 128.64, WHITE);
  display2.display();
  delay(1000);
}
